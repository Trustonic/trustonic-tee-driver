## trustonic/Kconfig
```kconfig
#
# Trustonic driver configuration
#
config TRUSTONIC_TEE
    tristate "Trustonic TEE Driver"
    depends on ARM || ARM64
    default y
    ---help---
      Enable Trustonic TEE support

config TRUSTONIC_TEE_LPAE
    bool "Trustonic TEE uses LPAE"
    depends on TRUSTONIC_TEE
    default y if ARM64
    default n if ARM
    ---help---
      Enable Trustonic TEE 64-bit physical addresses support

config MOBICORE_DEBUG
    bool "Trustonic TEE driver debug mode"
    depends on TRUSTONIC_TEE
    default n
    ---help---
      Enable the debug mode in the Trustonic TEE Driver.
```
